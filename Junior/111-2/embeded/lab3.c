//
// LCD_Game_Invader : emulate Space Invader game on LCD
//
// 5 rows of balls moving horizontally
// 1 cannon move on bottom & shoot vertically
// press keypad to move the cannon

#include <stdio.h>
#include <stdlib.h>
#include <string.h>
#include <math.h>
#include "NUC100Series.h"
#include "MCU_init.h"
#include "SYS_init.h"
#include "LCD.h"
#include "Scankey.h"

// bitmap is in upside down order
unsigned char bmp_Bullet[8] = {
	0x00,0x00,0x18,0x18,0x18,0x18,0x00,0x00};
unsigned char bmp_SmallBall[12] = {
	0x00,0x00,0x00,0x00,0x00,0x18,0x18,0x00,0x00,0x00,0x00,0x00};
unsigned char bmp_MidBall[12] = {
	0x00,0x00,0x00,0x00,0x1C,0x1C,0x1C,0x00,0x00,0x00,0x00,0x00};
unsigned char bmp_BigBall[12] = {
	0x00,0x00,0x00,0x00,0x3C,0x3C,0x3C,0x3C,0x00,0x00,0x00,0x00};
unsigned char bmp_Cannon[8] = {
	0x00,0x40,0xE0,0xF8,0xF8,0xE0,0x40,0x00};
unsigned char bmp_ball0[16] = {
	0x00,0x10,0x38,0x7C,0x36,0x1E,0x17,0x3F,0x3F,0x17,0x1E,0x36,0x7C,0x38,0x10,0x00};
unsigned char bmp_ball1[16] = {
	0x00,0x70,0x18,0x7D,0x36,0x34,0x3C,0x3C,0x3C,0x3C,0x34,0x36,0x7D,0x18,0x70,0x00};
unsigned char bmp_ball2[16] = {
	0x00,0x5C,0x30,0x1E,0x3F,0x1A,0x1A,0x1E,0x1E,0x1A,0x1A,0x3F,0x1E,0x30,0x5C,0x00};
unsigned char bmp_ball3[16] = {
	0x00,0x48,0x4C,0x2E,0x3E,0x1A,0x1B,0x2F,0x2F,0x1B,0x1A,0x3E,0x2E,0x4C,0x48,0x00};
unsigned char bmp_ball4[16] = {
	0x00,0x00,0x00,0x08,0x4C,0x2E,0x5B,0x2F,0x2F,0x5B,0x2E,0x4C,0x08,0x00,0x00,0x00};

unsigned char GameTitle[128*8] ={
	0x00,0x00,0x00,0x00,0x00,0x00,0x00,0x00,0x00,0x00,0x00,0x00,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0x00,
	0x00,0x00,0x00,0x00,0x00,0x00,0x00,0x00,0x00,0x00,0x00,0x00,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0x00,
	0x00,0x00,0x00,0x00,0x00,0x00,0x00,0x00,0x00,0x00,0x00,0x00,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0x00,
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 	0x00,0x00,0x00,0x00,0x00,0x00,0x00,0x00,0x00,0x00,0x00,0x00,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0x00
};

void Buzz(int8_t no)
{
	while(no!=0) {
		PB11=0;
		CLK_SysTickDelay(50000);
		PB11=1;
		CLK_SysTickDelay(50000);
	  no--;
	}
}

void Init_Buzz(void)
{
	GPIO_SetMode(PB, BIT11, GPIO_PMD_OUTPUT);
	PB11=1;
}

int main(void)
{
	char Text[25];
	int8_t x,y;
	int8_t i,j,k,keyin;
	int8_t hit;
	int16_t score;
	int8_t ball_no, bullet_no;

	int8_t small_num, mid_num, big_num;
	int8_t ball0_x[100], ball0_y[100], ball0_speed;
	int8_t ball1_x[100], ball1_y[100], ball1_speed;
	int8_t ball2_x[100], ball2_y[100], ball2_speed;
	int8_t cannon_x;
	int8_t cannon_y;
	
	int8_t bullet_x[8];
  int8_t bullet_y[8];
	int8_t bullet_speed;	
	
	int8_t ball_map0[100], ball_map1[100], ball_map2[100];
	int16_t ball_score[3] = {50, 30, 10};
	
	SYS_Init();
	  
	init_LCD();
	clear_LCD();
  OpenKeyPad();
	Init_Buzz();
	
	
		
	ball_no = rand()% 10;
	small_num = ball_no - rand()%ball_no;
	mid_num = ball_no - small_num - rand()%(ball_no-small_num);
	big_num = ball_no - mid_num - small_num;
	memset(ball_map0, 0, sizeof(ball_map0));
	memset(ball_map1, 0, sizeof(ball_map1));
	memset(ball_map2, 0, sizeof(ball_map2));
	
	draw_LCD(GameTitle);   // draw Game Title scene
	for (i=0;i<3;i++) CLK_SysTickDelay(1000000);
	clear_LCD();

	printS_5x7(0, 0,"LCD Game : Fighter Shoot");
	/*
	draw_Bmp16x8(26,16,FG_COLOR,BG_COLOR, bmp_ball1);	
	printS_5x7(46,16,"=  30 POINTS");
	draw_Bmp16x8(26,24,FG_COLOR,BG_COLOR, bmp_ball2);	
	printS_5x7(46,24,"=  25 POINTS");
	draw_Bmp16x8(26,32,FG_COLOR,BG_COLOR, bmp_ball3);	
	printS_5x7(46,32,"=  20 POINTS");	
	draw_Bmp16x8(26,40,FG_COLOR,BG_COLOR, bmp_ball4);	
	printS_5x7(46,40,"=  10 POINTS");
	draw_Bmp16x8(26,48,FG_COLOR,BG_COLOR, bmp_ball0);	
	printS_5x7(46,48,"= 300 POINTS");	
	*/
	printS_5x7(0,16, "Rules");
	printS_5x7(20, 24, "50 point / small ball");
	printS_5x7(20, 32, "30 points / mid ball");
	printS_5x7(20, 40, "10 point / big ball");
	printS_5x7(0,56,"Left:4, Shoot:2, Right:6");
	
	keyin=ScanKey();
  while(keyin==0) { keyin=ScanKey();}
	clear_LCD();

  // set initial location of bus & its speed
	
	ball0_speed=4;
	for(k=0;k<small_num;k++)
	{
		ball0_x[k] = rand()%116;
		ball0_y[k]=8;
	}
	ball1_speed=2;
	for(k=0;k<mid_num;k++)
	{
		ball1_x[k] = rand()%116;
		ball1_y[k]=8;
	}
	ball2_speed=1;
	for(k=0;k<big_num;k++)
	{
		ball2_x[k] = rand()%116;
		ball2_y[k]=8;
	}
	
	bullet_speed=1;
	hit=0; score=0; bullet_no=0;
	cannon_x=56; cannon_y=56;	
	for(j=0; j<8; j++) bullet_y[j]=0;
	

	while(1) {		
	// Display Score & Life
	sprintf(Text,"SCORE %3d       ball %2d",score, ball_no);	
	y=0; x=0;	printS_5x7(x,y,Text);	
	  if (hit==0)
	  {
		  // Display Ojbects : draw foreground color to display object
			for(i=0; i<small_num;i++)
			{
				if(ball_map0[i]==1)
					draw_Bmp16x8(ball0_x[i], ball0_y[i],FG_COLOR,BG_COLOR, bmp_SmallBall);
			}	
			for(i=0; i<mid_num;i++)
			{
				if(ball_map1[i]==1)
					draw_Bmp16x8(ball1_x[i], ball1_y[i],FG_COLOR,BG_COLOR, bmp_MidBall);
			}			
		  for(i=0; i<big_num;i++)
			{
				if(ball_map2[i]==1)
					draw_Bmp16x8(ball2_x[i], ball2_y[i],FG_COLOR,BG_COLOR, bmp_BigBall);
			}	
			
      for (i=0; i<8; i++) {
			  if (bullet_y[i]>8)
	         draw_Bmp8x8(bullet_x[i], bullet_y[i],FG_COLOR,BG_COLOR, bmp_Bullet); }
	    draw_Bmp8x8(cannon_x, cannon_y, FG_COLOR,BG_COLOR, bmp_Cannon); 
		
		  // Delay for Vision
		  CLK_SysTickDelay(10000);
		
		  // Erase Ojbects : draw background color at the ojbect location
			for(i=0; i<small_num;i++)
			{
				if(ball_map0[i]==1)
					draw_Bmp16x8(ball0_x[i], ball0_y[i],BG_COLOR,FG_COLOR, bmp_SmallBall);
			}	
			for(i=0; i<mid_num;i++)
			{
				if(ball_map1[i]==1)
					draw_Bmp16x8(ball1_x[i], ball1_y[i],BG_COLOR,FG_COLOR, bmp_MidBall);
			}			
		  for(i=0; i<big_num;i++)
			{
				if(ball_map2[i]==1)
					draw_Bmp16x8(ball2_x[i], ball2_y[i],BG_COLOR,FG_COLOR, bmp_BigBall);
			}	
			
      for (i=0; i<8; i++) {
			  if (bullet_y[i]>8)
	        draw_Bmp8x8(bullet_x[i], bullet_y[i],BG_COLOR,FG_COLOR, bmp_Bullet); }
				 
	    draw_Bmp8x8(cannon_x, cannon_y, BG_COLOR,FG_COLOR, bmp_Cannon);		

	    // Object Move by changing its x,y		
		  keyin=ScanKey(); // get keypad
		  switch(keyin) {  
			case 4: cannon_x--;  
				      break;
			case 6: cannon_x++;  
				      break;
			case 2: bullet_no++;
				      if (bullet_no>=8) bullet_no=0;
					    bullet_x[bullet_no] =cannon_x;
				      bullet_y[bullet_no] =cannon_y-8;
				      break;
			default:break;
		  }	
			
			for (i=0; i<8; i++)
			  if (bullet_y[i]>8) 
			  bullet_y[i] -= bullet_speed;
				
	    //inc/dec ball x for moving horizontally
			for(i=0;i<small_num;i++)
			{
				ball0_y[i] += ball0_speed;
			}
		  for(i=0;i<mid_num;i++)
			{
				ball1_y[i] += ball1_speed;
			}
			for(i=0;i<big_num;i++)
			{
				ball2_y[i] +=ball2_speed;
			}
	 			
	    /*
			// Boundary Check : if >max, set to min; if <min, set to max;
			if (ball_map[0]==1) {
		    if (ball0_x<0)                  ball0_x=LCD_Xmax-16;
		    if (ball0_x>(LCD_Xmax-16))      ball0_x=0;			
			}
			*/
			
			/*
			for (i=0; i<5; i++) {
				if (ball_map[1*5+i]==1) {
		      if (ball1_x[i]<0)             ball1_x[i]=LCD_Xmax-16;
		      if (ball1_x[i]>(LCD_Xmax-16)) ball1_x[i]=0; }
				if (ball_map[2*5+i]==1) {
		      if (ball2_x[i]<0)             ball2_x[i]=LCD_Xmax-16;
		      if (ball2_x[i]>(LCD_Xmax-16)) ball2_x[i]=0;	}
				if (ball_map[3*5+i]==1) {
		      if (ball3_x[i]<0)             ball3_x[i]=LCD_Xmax-16;
		      if (ball3_x[i]>(LCD_Xmax-16)) ball3_x[i]=0; }
				if (ball_map[4*5+i]==1) {
		      if (ball4_x[i]<0)             ball4_x[i]=LCD_Xmax-16;
		      if (ball4_x[i]>(LCD_Xmax-16)) ball4_x[i]=0;	}
			}*/
			
			for(i=0;i<small_num;i++)
			{
				if(ball_map0[i]==1)
					if(ball0_y<0) ball_map0[i] = 0;
			}
			for(i=0;i<mid_num;i++)
			{
				if(ball_map1[i]==1)
					if(ball1_y<0) ball_map1[i] = 0;
			}
			for(i=0;i<big_num;i++)
			{
				if(ball_map2[i]==1)
					if(ball2_y<0) ball_map2[i] = 0;
			}
		
		  //if (cannon_x>128)	cannon_x=0;
      if (cannon_x<=0)             cannon_x=120;
				
	    // Collision Detection : check if Frog hit by Bus		
			for (j=0; j<8; j++) {// check bullets (max=8)
				/*
				if ((ball_map[0]!=0) &&
		        (bullet_y[j]+4 >=ball0_y && bullet_y[j]+3 <ball0_y+8))   // if bullet overlap ball
				   if (bullet_x[j]+4 >=ball0_x && bullet_x[j]+3 <ball0_x+16) // check bullet_x				
				      {hit=1; bullet_y[j]=0; score+=ball_score[0]; ball_map[0]=0;} 
				for (i=0; i<5; i++) {
				if ((ball_map[1*5+i]!=0) &&
		        (bullet_y[j]+4>=ball1_y && bullet_y[j]+3<ball1_y+8))
			     if (bullet_x[j]+4>=ball1_x[i] && bullet_x[j]+3<ball1_x[i]+16) 
					    {hit=1; bullet_y[j]=0; score+=ball_score[1]; ball_map[1*5+i]=0;}
				if ((ball_map[2*5+i]!=0) &&							
		        (bullet_y[j]+4>=ball2_y && bullet_y[j]+3<ball2_y+8))					
			     if (bullet_x[j]+4>=ball2_x[i] && bullet_x[j]+3<ball2_x[i]+16) 
						  {hit=1; bullet_y[j]=0; score+=ball_score[2]; ball_map[2*5+i]=0;}
			  if ((ball_map[3*5+i]!=0) &&								
		        (bullet_y[j]+4>=ball3_y && bullet_y[j]+3<ball3_y+8))
			     if (bullet_x[j]+4>=ball3_x[i] && bullet_x[j]+3<ball3_x[i]+16)
						  {hit=1; bullet_y[j]=0; score+=ball_score[3]; ball_map[3*5+i]=0;}
			  if ((ball_map[4*5+i]!=0) &&							
		        (bullet_y[j]+4>=ball4_y && bullet_y[j]+3<ball4_y+8))
			     if (bullet_x[j]+4>=ball4_x[i] && bullet_x[j]+3<ball4_x[i]+16)
						  {hit=1; bullet_y[j]=0; score+=ball_score[4]; ball_map[4*5+i]=0;}
	      }			
				*/
				for(i=0;i<small_num;i++)
				{
					if((bullet_x[j]==ball0_x[i])&&(bullet_y[j]==ball0_y[i]))
					{
						hit=1; bullet_y[j]=0; score+=ball_score[0]; ball_map0[i]=0; ball_no-=1;
					}
				}
				for(i=0;i<mid_num;i++)
				{
					if((bullet_x[j]==ball1_x[i])&&(bullet_y[j]==ball1_y[i]))
					{
						hit=1; bullet_y[j]=0; score+=ball_score[1]; ball_map1[i]=0; ball_no-=1;
					}
				}for(i=0;i<big_num;i++)
				{
					if((bullet_x[j]==ball2_x[i])&&(bullet_y[j]==ball2_y[i]))
					{
						hit=1; bullet_y[j]=0; score+=ball_score[2]; ball_map2[i]=0; ball_no-=1;
					}
				}
			  
			}
		}
		else { 
			Buzz(1); // buzz for hit
			hit=0; 			
			if (ball_no==0) {
				x=0; y=32; printS_5x7(x,y,"  =====  YOU FINISH  =====  ");
			  printS_5x7( 0,56,"Press Any Key To Start!");
	      keyin=ScanKey();
        while(keyin==0) { keyin=ScanKey();}
	      clear_LCD();				
	      for(k=0;k<small_num;k++)
				{
					ball0_x[k] = rand()%116;
					ball0_y[k]=8;
				}
				for(k=0;k<mid_num;k++)
				{
					ball1_x[k] = rand()%116;
					ball1_y[k]=8;
				}
				for(k=0;k<big_num;k++)
				{
					ball2_x[k] = rand()%116;
					ball2_y[k]=8;
				}				
	      hit=0; score=0; ball_no = rand()% 10;;
	      cannon_x=56; cannon_y=56;	
	      for(j=0; j<8; j++) bullet_y[j]=0;
	      memset(ball_map0, 0, sizeof(ball_map0));
				memset(ball_map1, 0, sizeof(ball_map1));
				memset(ball_map2, 0, sizeof(ball_map2));
		  }					
	  }
  }
}
